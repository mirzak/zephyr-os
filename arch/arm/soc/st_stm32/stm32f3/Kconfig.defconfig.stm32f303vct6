## arch/arm/soc/st_stm32/stm32f3/Kconfig.defconfig.stm32f303vct6
```kconfig
# Kconfig - ST Microelectronics STM32F303VCT6 MCU
#
# Copyright (c) 2016 Mirza Krak
#
# Licensed under the Apache License, Version 2.0 (the "License");
# you may not use this file except in compliance with the License.
# You may obtain a copy of the License at
#
#     http://www.apache.org/licenses/LICENSE-2.0
#
# Unless required by applicable law or agreed to in writing, software
# distributed under the License is distributed on an "AS IS" BASIS,
# WITHOUT WARRANTIES OR CONDITIONS OF ANY KIND, either express or implied.
# See the License for the specific language governing permissions and
# limitations under the License.
#

if SOC_STM32F303VCT6

config SOC
	string
	default stm32f303vct6
config SRAM_SIZE
	default 40

config FLASH_SIZE
	default 256

config NUM_IRQS
	int
	default 72

endif # SOC_STM32F303VCT6
```

## drivers/interrupt_controller/Kconfig.stm32
```kconfig
# Kconfig - STM32 EXTI configuration
#
# Copyright (c) 2016 Open-RnD Sp. z o.o.
#
# Licensed under the Apache License, Version 2.0 (the "License");
# you may not use this file except in compliance with the License.
# You may obtain a copy of the License at
#
#     http://www.apache.org/licenses/LICENSE-2.0
#
# Unless required by applicable law or agreed to in writing, software
# distributed under the License is distributed on an "AS IS" BASIS,
# WITHOUT WARRANTIES OR CONDITIONS OF ANY KIND, either express or implied.
# See the License for the specific language governing permissions and
# limitations under the License.
#

if SOC_FAMILY_STM32

config EXTI_STM32
	bool "External Interrupt/Event Controller (EXTI) Driver for STM32 family of MCUs"
	default y if SOC_FAMILY_STM32
	help
	 Enable EXTI driver for STM32 line of MCUs

config EXTI_STM32_EXTI0_IRQ_PRI
	int "EXTI0 IRQ priority"
	depends on EXTI_STM32
	default 0
	help
	 IRQ priority of EXTI0 interrupt

config EXTI_STM32_EXTI1_IRQ_PRI
	int "EXTI1 IRQ priority"
	depends on EXTI_STM32
	default 0
	help
	 IRQ priority of EXTI1 interrupt

config EXTI_STM32_EXTI2_IRQ_PRI
	int "EXTI2 IRQ priority"
	depends on EXTI_STM32
	default 0
	help
	 IRQ priority of EXTI2 interrupt

config EXTI_STM32_EXTI3_IRQ_PRI
	int "EXTI3 IRQ priority"
	depends on EXTI_STM32
	default 0
	help
	 IRQ priority of EXTI3 interrupt

config EXTI_STM32_EXTI4_IRQ_PRI
	int "EXTI4 IRQ priority"
	depends on EXTI_STM32
	default 0
	help
	 IRQ priority of EXTI4 interrupt

config EXTI_STM32_EXTI9_5_IRQ_PRI
	int "EXTI9:5 IRQ priority"
	depends on EXTI_STM32
	default 0
	help
	 IRQ priority of EXTI9:5 interrupt

config EXTI_STM32_EXTI15_10_IRQ_PRI
	int "EXTI15:10 IRQ priority"
	depends on EXTI_STM32
	default 0
	help
	 IRQ priority of EXTI15:10 interrupt

config EXTI_STM32_EXTI16_IRQ_PRI
	int "EXTI16 IRQ priority"
	depends on EXTI_STM32
	default 0
	help
	 IRQ priority of EXTI16 interrupt

config EXTI_STM32_EXTI18_IRQ_PRI
	int "EXTI18 IRQ priority"
	depends on EXTI_STM32
	default 0
	help
	 IRQ priority of EXTI18 interrupt

config EXTI_STM32_EXTI19_IRQ_PRI
	int "EXTI19 IRQ priority"
	depends on EXTI_STM32
	default 0
	help
	 IRQ priority of EXTI19 interrupt

config EXTI_STM32_EXTI20_IRQ_PRI
	int "EXTI20 IRQ priority"
	depends on EXTI_STM32
	default 0
	help
	 IRQ priority of EXTI20 interrupt

config EXTI_STM32_EXTI21_22_29_IRQ_PRI
	int "EXTI 21,22,29 IRQ priority"
	depends on EXTI_STM32
	default 0
	help
	 IRQ priority of EXTI 21,22, 29 interrupts

config EXTI_STM32_EXTI23_IRQ_PRI
	int "EXTI23 IRQ priority"
	depends on EXTI_STM32
	default 0
	help
	 IRQ priority of EXTI23 interrupt

config EXTI_STM32_EXTI24_IRQ_PRI
	int "EXTI24 IRQ priority"
	depends on EXTI_STM32
	default 0
	help
	 IRQ priority of EXTI24 interrupt

config EXTI_STM32_EXTI25_IRQ_PRI
	int "EXTI25 IRQ priority"
	depends on EXTI_STM32
	default 0
	help
	 IRQ priority of EXTI25 interrupt

config EXTI_STM32_EXTI26_IRQ_PRI
	int "EXTI26 IRQ priority"
	depends on EXTI_STM32
	default 0
	help
	 IRQ priority of EXTI26 interrupt

config EXTI_STM32_EXTI28_IRQ_PRI
	int "EXTI28 IRQ priority"
	depends on EXTI_STM32
	default 0
	help
	 IRQ priority of EXTI28 interrupt

config EXTI_STM32_EXTI30_31_32_IRQ_PRI
	int "EXTI 30,31,32 IRQ priority"
	depends on EXTI_STM32
	default 0
	help
	 IRQ priority of EXTI 30,31 32 interrupts

config EXTI_STM32_EXTI33_IRQ_PRI
	int "EXTI33 IRQ priority"
	depends on EXTI_STM32
	default 0
	help
	 IRQ priority of EXTI33 interrupt

config EXTI_STM32_EXTI34_IRQ_PRI
	int "EXTI34 IRQ priority"
	depends on EXTI_STM32
	default 0
	help
	 IRQ priority of EXTI34 interrupt


config EXTI_STM32_EXTI35_IRQ_PRI
	int "EXTI35 IRQ priority"
	depends on EXTI_STM32
	default 0
	help
	 IRQ priority of EXTI35 interrupt

endif # SOC_FAMILY_STM32
```
